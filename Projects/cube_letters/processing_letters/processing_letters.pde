/*
Draw letters and numbers on the cube
*/


boolean usePort = true; //set this to false if you aren't displaying it on the physical cube
String message = "Love&Joy";
int messageIndex = 0;
int startTime = 0;
int slideDuration = 500;
int letterDuration = 1500;

//color textColor = color(253,134,170);
color textColor = color(255,15,15);
color bgColor = color(0, 0, 64);
boolean useRainbowText = false;
int hueIndex = 0;
int hueSpeed = 10;
int maxHue = 1000;


/*
 * 0 = show text message
 * 1 = show a series of symbols
 * 2 = show current time
*/
int displayMode = 0;

String[] imageFilenames = "anchor.png,circle.png,crown.png,diamond.png,dollar.png,down.png,heart.png,horseshoe.png,moon.png,peace.png,plus.png,raindrop.png,star.png".split(",");
ArrayList<PImage> images = new ArrayList<PImage>();
int imageIndex = 0;


int ledsPerEdge = 8; //number of LEDs per edge
float cmBetweenLEDs = 3.5;
float cmCameraToCube = 100;


//Serial
import processing.serial.*;
Serial port;

// list of LEDs (sorry this is poorly named, these are the LEDs)
LED[] leds = new LED[ledsPerEdge*ledsPerEdge*ledsPerEdge];

/*
neopixel gamma correction

NOTE: THIS IS THE LAST THING I ADDED SINCE THE LEDS STARTED OCCASIONALLY FLASHING RANDOM COLORS
*/
int gamma[] = {
    0,  0,  0,  0,  0,  0,  0,  0,  0,  0,  0,  0,  0,  0,  0,  0,
    0,  0,  0,  0,  0,  0,  0,  0,  0,  0,  0,  0,  1,  1,  1,  1,
    1,  1,  1,  1,  1,  1,  1,  1,  1,  2,  2,  2,  2,  2,  2,  2,
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  215,218,220,223,225,228,231,233,236,239,241,244,247,249,252,255 };

char[][] font8x8_basic = new char[][]{
    { 0x00, 0x00, 0x00, 0x00, 0x00, 0x00, 0x00, 0x00},   // U+0000 (nul)
    { 0x00, 0x00, 0x00, 0x00, 0x00, 0x00, 0x00, 0x00},   // U+0001
    { 0x00, 0x00, 0x00, 0x00, 0x00, 0x00, 0x00, 0x00},   // U+0002
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    { 0x00, 0x00, 0x00, 0x00, 0x00, 0x00, 0x00, 0x00}    // U+007F
};


void setup() {
  //open a port so we can use our serial connection to communicate to the physical cube
  if(usePort) {
    port = new Serial(this, Serial.list()[0], 921600); // open port
  }

  //load in all the images
  for(String filename : imageFilenames) {
    PImage img = loadImage(filename);
    images.add(img);
  }

  //frameRate(6.5); //predicted max framerate given 115200 baud rate
  size(640, 480, P3D);

  //initialize the cube
  int i = 0;
  for(int xi = 0; xi < 8; xi++) {
    for(int yi = 0; yi < 8; yi++) {
      for(int zi = 0; zi < 8; zi++) {
        leds[i] = new LED((xi-4)*cmBetweenLEDs, (yi-4)*cmBetweenLEDs, (zi-4)*cmBetweenLEDs);
        leds[i].ledColor = color(xi*(256/8), yi*(256/8), zi*(256/8)); //map each axis to a color channel
        i++;
      }
    }
  } //end cube initialization
} //end setup()


void draw() {
  background(30);
  lights();

  if(startTime == 0) {
    startTime = millis();
  }

  // Center cube in display window
  translate(width/2, height/2, cmCameraToCube);
  float fov = 10*DEG_TO_RAD;
  
  //compute optimal fov
  float edgeLength = (ledsPerEdge-1) * cmBetweenLEDs;
  float centerToCornerDist = dist(0,0,0,edgeLength/2,edgeLength/2,edgeLength/2);

  fov = tan(centerToCornerDist/cmCameraToCube) / 1.7; //1.7 is just a number I happened to pick
  
  perspective(fov, width/(float)height, 0.1, 1000);


  //angle at which the cube should be viewed

  //float mX = 0.15937495;
  //float mY = 0.0958333;
  
  float mX = 0.115625024;
  float mY = -0.40833336;

  //float mX = map(mouseX,0,width,-1,1);
  //float mY = map(mouseY,0,height,-1,1);
  //println(mX+","+mY);
  
  rotateZ(0.5*PI);
  rotateY(mY*PI);
  rotateZ(mX*PI);
  //rotateX(mX*PI);

  //find the screen bounds of the cube
  float minCubeX = width;
  float maxCubeX = 0;
  float minCubeY = height;
  float maxCubeY = 0;
  for(LED led : leds) {
    float x = screenX(led.position.x, led.position.y, led.position.z);
    float y = screenY(led.position.x, led.position.y, led.position.z);

    if(x < minCubeX)
      minCubeX = x;
    if(x > maxCubeX)
      maxCubeX = x;
    if(y < minCubeY)
      minCubeY = y;
    if(y > maxCubeY)
      maxCubeY = y;
  }

  //byte allRGB[] = new byte[3*512]; //stores frame of all colors to send to arduino
  //int i = 0;
  //for(LED led : leds) {
    
    
    
  //  //gamma adjust the colors so they look more natural, then save them to the cube frame buffer
  //  allRGB[i*3+0] = (byte)gamma[255]; //red
  //  allRGB[i*3+1] = (byte)gamma[255]; //green
  //  allRGB[i*3+2] = (byte)gamma[255]; //blue
  //  i++;
  //}

  byte allRGB[] = new byte[3*512]; //stores frame of all colors to send to arduino
  int m = millis() - startTime;
  
  int depth = 7;
  int slideTime = m % letterDuration;
  if(slideTime <= slideDuration) {
    depth = int(slideTime * 7 / slideDuration);
  }
  
  if(displayMode == 0 || displayMode == 2) {
    if(displayMode == 2) {
      String hourString = "" + (hour() % 12);
      if(hourString.equals("0")) {
        hourString = "12";
      }
      
      String minuteString = String.format("%02d", minute());
      message = hourString+":"+minuteString+" ";
    }
    
    messageIndex = (m/letterDuration) % message.length();
    int char_index = (int)(message.charAt(messageIndex));
    char[] letter = font8x8_basic[ char_index ];
    
    int i = 0;
    for(int z = 0; z < 8; z++) {
      for(int y = 0; y < 8; y++) {
        for(int x = 0; x < 8; x++) {
          char row = letter[7-x];
          String binary_string = String.format("%8s", Integer.toBinaryString((int)row)).replace(' ', '0');
          //println(binary_string);

          int r = (int)red(bgColor);
          int g = (int)green(bgColor);
          int b = (int)blue(bgColor);
          
          
          boolean led_is_on = binary_string.charAt(y) == '1';
          if(z == depth && led_is_on) {
            if(useRainbowText) {
              colorMode(HSB, maxHue);
              color rainbowColor = color(hueIndex, maxHue, maxHue);
              colorMode(RGB, 255);
              
              r = (int)red(rainbowColor);
              g = (int)green(rainbowColor);
              b = (int)blue(rainbowColor);
            }
            else {
              r = (int)red(textColor);
              g = (int)green(textColor);
              b = (int)blue(textColor);
            }
          }
          
          //colorMode(RGB, 255);
          leds[i].ledColor = color(r, g, b); //map each axis to a color channel
          allRGB[i*3+0] = (byte)gamma[r]; //red
          allRGB[i*3+1] = (byte)gamma[g]; //green
          allRGB[i*3+2] = (byte)gamma[b]; //blue
          
          i++;
        }
      }
    }
    
    hueIndex += hueSpeed;
    hueIndex = hueIndex % maxHue;
    
    
  } //otherwise show the symbols
  else if(displayMode == 1) {
    imageIndex = (m/letterDuration) % images.size();
    
    PImage img = images.get(imageIndex);
    
    int i = 0;
    for(int z = 0; z < 8; z++) {
      for(int y = 0; y < 8; y++) {
        for(int x = 0; x < 8; x++) {
          int r = 0;
          int g = 0;
          int b = 40;
          
          boolean led_is_on = img.get(7-y, 7-x) == color(255);
          if(z == depth && led_is_on) {
            r = 200;
            g = 0;
            b = 0;
          }
          
          leds[i].ledColor = color(r, g, b); //map each axis to a color channel
          allRGB[i*3+0] = (byte)gamma[r]; //red
          allRGB[i*3+1] = (byte)gamma[g]; //green
          allRGB[i*3+2] = (byte)gamma[b]; //blue
  
          i++;
        }
      }
    }

  }
  
  
  
  

  //send the frame to the arduino
  if(usePort) {
    port.write(allRGB);
  }


  // Move and rotate leds
  for (LED led : leds) {
    led.update();
    led.display();
  }
}


// Represents color and position of a single LED
class LED {
  PVector position;
  color ledColor = color(255);

  LED(float x, float y, float z) {
    position = new PVector(x, y, z);
  }

  // Update function for potential future use
  void update() {
  }

  // Aproximate the shape of the LED with a sphere
  void display() {
    pushMatrix();
    translate(position.x, position.y, position.z);
    noStroke();
    
    //fill(ledColor);
    fill(color(red(ledColor), green(ledColor), blue(ledColor), 128));
    
    sphere(1.27/2);
    popMatrix();
  }
}